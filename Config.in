## Config.in
```kconfig
menu "Configuration"
        depends on PACKAGE_qmiserial2qmuxd

config QMI_SERIAL_2_QMUXD_CUSTOM_SOCKET
        bool "Enable custom socket"
		default n

config QMI_SERIAL_2_QMUXD_CUSTOM_SOCKET_NAME
        string "Custom socket name"
        depends on QMI_SERIAL_2_QMUXD_CUSTOM_SOCKET
		default qmi-proxy

endmenu
```
